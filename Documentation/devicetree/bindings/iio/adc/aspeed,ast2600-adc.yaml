## Documentation/devicetree/bindings/pinctrl/aspeed,ast2700-soc0-pinctrl.yaml
```yaml
# SPDX-License-Identifier: (GPL-2.0-only OR BSD-2-Clause)
%YAML 1.2
---
$id: http://devicetree.org/schemas/pinctrl/aspeed,ast2700-soc0-pinctrl.yaml#
$schema: http://devicetree.org/meta-schemas/core.yaml#

title: ASPEED AST2700 SoC0 Pin Controller

maintainers:
  - Billy Tsai <billy_tsai@aspeedtech.com>

description: |
  Bindings for the ASPEED AST2700 SoC0 Pin Controller.

properties:
  compatible:
    const: aspeed,ast2700-soc0-pinctrl

additionalProperties:
  $ref: pinmux-node.yaml#
  additionalProperties: false

  properties:
    function:
      enum:
        - EMMC
        - VGADDC
        - USB3A
        - USB2A
        - USB3B
        - USB2B
        - JTAG0
        - PCIERC

    groups:
      enum:
        - EMMCG1
        - EMMCG4
        - EMMCG8
        - EMMCWPN
        - EMMCCDN
        - VGADDC
        - USB3AXHD
        - USB3AXHPD
        - USB3AXH
        - USB3AXHP
        - USB3AXH2B
        - USB3AXHP2B
        - USB2AXHD1
        - USB2AXHPD1
        - USB2AD1
        - USB2AXH
        - USB2AXHP
        - USB2AXH2B
        - USB2AXHP2B
        - USB2AHPD0
        - USB2AD0
        - USB2AH
        - USB2AHP
        - USB3BXHD
        - USB3BXHPD
        - USB3BXH
        - USB3BXHP
        - USB3BXH2A
        - USB3BXHP2A
        - USB2BXHD1
        - USB2BXHPD1
        - USB2BD1
        - USB2BXH
        - USB2BXHP
        - USB2BXH2A
        - USB2BXHP2A
        - USB2BHPD0
        - USB2BD0
        - USB2BH
        - USB2BHP
        - JTAGM0
        - PSP
        - SSP
        - TSP
        - DDR
        - USB3A
        - USB3B
        - PCIEA
        - PCIEB
        - PCIERC0PERST
        - PCIERC1PERST

    pins:
      $ref: /schemas/types.yaml#/definitions/string-array
    drive-strength:
      minimum: 0
      maximum: 15

allOf:
  - $ref: pinctrl.yaml#

required:
  - compatible

examples:
  - |
    pinctrl0: pinctrl{
        compatible = "aspeed,ast2700-soc0-pinctrl";

        pinctrl_emmc_default: emmc-default {
            function = "EMMC";
            groups = "EMMCG1";
        };

        pinctrl_emmcclk_driving: emmcclk-driving {
            pins = "AC14";
            drive-strength = <2>;
        };
    };
```

## Documentation/devicetree/bindings/pinctrl/aspeed,ast2700-soc1-pinctrl.yaml
```yaml
# SPDX-License-Identifier: (GPL-2.0-only OR BSD-2-Clause)
%YAML 1.2
---
$id: http://devicetree.org/schemas/pinctrl/aspeed,ast2700-soc1-pinctrl.yaml#
$schema: http://devicetree.org/meta-schemas/core.yaml#

title: ASPEED AST2700 SoC1 Pin Controller

maintainers:
  - Billy Tsai <billy_tsai@aspeedtech.com>

description: |
  Bindings for the ASPEED AST2700 SoC1 Pin Controller.

properties:
  compatible:
    const: aspeed,ast2700-soc1-pinctrl

additionalProperties:
  $ref: pinmux-node.yaml#
  additionalProperties: false

  properties:
    function:
      enum:
        - ADC0
        - ADC1
        - ADC2
        - ADC3
        - ADC4
        - ADC5
        - ADC6
        - ADC7
        - ADC8
        - ADC9
        - ADC10
        - ADC11
        - ADC12
        - ADC13
        - ADC14
        - ADC15
        - CANBUS
        - DDR
        - ESPI0
        - ESPI1
        - FSI0
        - FSI1
        - FSI2
        - FSI3
        - FWQSPI
        - I2C0
        - I2C1
        - I2C2
        - I2C3
        - I2C4
        - I2C5
        - I2C6
        - I2C7
        - I2C8
        - I2C9
        - I2C10
        - I2C11
        - I2C12
        - I2C13
        - I2C14
        - I2C15
        - I3C0
        - I3C1
        - I3C2
        - I3C3
        - I3C4
        - I3C5
        - I3C6
        - I3C7
        - I3C8
        - I3C9
        - I3C10
        - I3C11
        - I3C12
        - I3C13
        - I3C14
        - I3C15
        - JTAGM0
        - JTAGM1
        - LPC0
        - LPC1
        - LTPI_PS_I2C0
        - LTPI_PS_I2C1
        - LTPI_PS_I2C2
        - LTPI_PS_I2C3
        - MDIO0
        - MDIO1
        - MDIO2
        - NCTS5
        - NDCD5
        - NDSR5
        - NRI5
        - PCIERC
        - PWM0
        - PWM1
        - PWM2
        - PWM3
        - PWM4
        - PWM5
        - PWM6
        - PWM7
        - PWM8
        - PWM9
        - PWM10
        - PWM11
        - PWM12
        - PWM13
        - PWM14
        - PWM15
        - QSPI0
        - QSPI1
        - QSPI2
        - RGMII0
        - RGMII1
        - RMII0
        - RMII0RCLKO
        - RMII1
        - RMII1RCLKO
        - SALT0
        - SALT1
        - SALT2
        - SALT3
        - SALT4
        - SALT5
        - SALT6
        - SALT7
        - SALT8
        - SALT9
        - SALT10
        - SALT11
        - SALT12
        - SALT13
        - SALT14
        - SALT15
        - SD
        - SGMII
        - SGPM0
        - SGPM1
        - SGPS
        - SPI0
        - SPI0CS1
        - SPI1
        - SPI1CS1
        - SPI2
        - SPI2CS1
        - SSP
        - TACH0
        - TACH1
        - TACH2
        - TACH3
        - TACH4
        - TACH5
        - TACH6
        - TACH7
        - TACH8
        - TACH9
        - TACH10
        - TACH11
        - TACH12
        - TACH13
        - TACH14
        - TACH15
        - THRU0
        - THRU1
        - THRU2
        - THRU3
        - TSP
        - UART0
        - UART1
        - UART2
        - UART3
        - UART5
        - UART6
        - UART7
        - UART8
        - UART9
        - UART10
        - UART11
        - USB2C
        - USB2D
        - VPI

    groups:
      enum:
        - ADC0
        - ADC1
        - ADC2
        - ADC3
        - ADC4
        - ADC5
        - ADC6
        - ADC7
        - ADC8
        - ADC9
        - ADC10
        - ADC11
        - ADC12
        - ADC13
        - ADC14
        - ADC15
        - CANBUS
        - DI2C0
        - DI2C1
        - DI2C2
        - DI2C3
        - DI2C8
        - DI2C9
        - DI2C10
        - DI2C11
        - DI2C12
        - DI2C13
        - DI2C14
        - DI2C15
        - DSGPM0
        - ESPI0
        - ESPI1
        - FSI0
        - FSI1
        - FSI2
        - FSI3
        - FWQSPI
        - HVI3C0
        - HVI3C1
        - HVI3C2
        - HVI3C3
        - HVI3C12
        - HVI3C13
        - HVI3C14
        - HVI3C15
        - I2C0
        - I2C1
        - I2C2
        - I2C3
        - I2C4
        - I2C5
        - I2C6
        - I2C7
        - I2C8
        - I2C9
        - I2C10
        - I2C11
        - I2C12
        - I2C13
        - I2C14
        - I2C15
        - I3C4
        - I3C5
        - I3C6
        - I3C7
        - I3C8
        - I3C9
        - I3C10
        - I3C11
        - JTAGM1
        - LPC0
        - LPC1
        - LTPI_PS_I2C0
        - LTPI_PS_I2C1
        - LTPI_PS_I2C2
        - LTPI_PS_I2C3
        - MDIO0
        - MDIO1
        - MDIO2
        - NCTS0
        - NCTS1
        - NCTS5
        - NCTS6
        - NDCD0
        - NDCD1
        - NDCD5
        - NDCD6
        - NDSR0
        - NDSR1
        - NDSR5
        - NDSR6
        - NDTR0
        - NDTR1
        - NDTR5
        - NDTR6
        - NRI0
        - NRI1
        - NRI5
        - NRI6
        - NRTS0
        - NRTS1
        - NRTS5
        - NRTS6
        - PE2SGRSTN
        - PWM0
        - PWM1
        - PWM2
        - PWM3
        - PWM4
        - PWM5
        - PWM6
        - PWM7
        - PWM8
        - PWM9
        - PWM10
        - PWM11
        - PWM12
        - PWM13
        - PWM14
        - PWM15
        - QSPI0
        - QSPI1
        - QSPI2
        - RGMII0
        - RGMII1
        - RMII0
        - RMII0RCLKO
        - RMII1
        - RMII1RCLKO
        - RXD0
        - RXD1
        - RXD2
        - RXD3
        - RXD5
        - RXD6
        - RXD7
        - RXD8
        - RXD9
        - RXD10
        - RXD11
        - SALT0
        - SALT1
        - SALT2
        - SALT3
        - SALT4
        - SALT5
        - SALT6
        - SALT7
        - SALT8
        - SALT9
        - SALT10
        - SALT11
        - SALT12
        - SALT13
        - SALT14
        - SALT15
        - SD
        - SGMII
        - SGPM0
        - SGPM1
        - SGPS
        - SPI0
        - SPI0CS1
        - SPI1
        - SPI1CS1
        - SPI2
        - SPI2CS1
        - TACH0
        - TACH1
        - TACH2
        - TACH3
        - TACH4
        - TACH5
        - TACH6
        - TACH7
        - TACH8
        - TACH9
        - TACH10
        - TACH11
        - TACH12
        - TACH13
        - TACH14
        - TACH15
        - THRU0
        - THRU1
        - THRU2
        - THRU3
        - TXD0
        - TXD1
        - TXD2
        - TXD3
        - TXD5
        - TXD6
        - TXD7
        - TXD8
        - TXD9
        - TXD10
        - TXD11
        - USB2CD
        - USB2CH
        - USB2CU
        - USB2CUD
        - USB2DD
        - USB2DH
        - VPI

    pins:
      $ref: /schemas/types.yaml#/definitions/string-array
    bias-disable:
      type: boolean
    bias-pull-down:
      type: boolean
    bias-pull-up:
      type: boolean
    drive-strength:
      minimum: 0
      maximum: 3
    power-source:
      enum: [1800, 3300]

allOf:
  - $ref: pinctrl.yaml#

required:
  - compatible

examples:
  - |
    pinctrl1: pinctrl {
        compatible = "aspeed,ast2700-soc1-pinctrl";

        pinctrl_hvi3c0_default: hvi3c0-default {
            function = "I3C0";
            groups = "HVI3C0";
        };

        pinctrl_i3c0_3_hv_voltage: i3chv-voltage {
            pins = "U25";
            power-source = <1800>;
        };

        pinctrl_i3c0_driving: i3c0-driving {
            pins = "U25", "U26";
            drive-strength = <2>;
        };
    };
```

## Documentation/devicetree/bindings/rtc/aspeed,rtc.yaml
```yaml
# SPDX-License-Identifier: GPL-2.0-only OR BSD-2-Clause
%YAML 1.2
---
$id: http://devicetree.org/schemas/rtc/aspeed,rtc.yaml#
$schema: http://devicetree.org/meta-schemas/core.yaml#

title: ASPEED Always-On RTC

maintainers:
  - Tommy Huang <tommy_huang@aspeedtech.com>

description:
  The ASPEED Always-On RTC (AONRTC) is an APB-connected real-time clock
  found on ASPEED AST27xx SoCs. It is powered by a dedicated always-on
  power domain backed by an external battery (VDD_BAT), allowing the RTC
  to continue timekeeping when the main power supply (VDD_CORE) is removed.

properties:
  compatible:
    enum:
      - aspeed,ast2705-aonrtc
      - aspeed,ast2755-aonrtc

  reg:
    maxItems: 1
    description: Base address and length of the AONRTC register block.

  interrupts:
    maxItems: 1
    description:
      Single interrupt line shared by the alarm event and the battery
      switch-over event.

  resets:
    maxItems: 1
    description: Reset control for the AONRTC block in the SCU.

required:
  - compatible
  - reg
  - interrupts
  - resets

additionalProperties: false

examples:
  - |
    #include <dt-bindings/reset/aspeed,ast2700-scu.h>

    rtc@14c01000 {
        compatible = "aspeed,ast2705-aonrtc";
        reg = <0x0 0x14c01000 0x0 0x100>;
        resets = <&syscon1 SCU1_RESET_AONRTC>;
        interrupts-extended = <&intc1_1 24>;
        status = "okay";
    };
```

## drivers/i3c/Kconfig
```kconfig
# SPDX-License-Identifier: GPL-2.0

menuconfig I3C
	tristate "I3C support"
	select I2C
	help
	  I3C is a serial protocol standardized by the MIPI alliance.

	  It's supposed to be backward compatible with I2C while providing
	  support for high speed transfers and native interrupt support
	  without the need for extra pins.

	  The I3C protocol also standardizes the slave device types and is
	  mainly designed to communicate with sensors.

	  If you want I3C support, you should say Y here and also to the
	  specific driver for your bus adapter(s) below.

	  This I3C support can also be built as a module.  If so, the module
	  will be called i3c.

if I3C

config I3CDEV
	tristate "I3C device interface"
	depends on I3C
	help
	  Say Y here to use i3c-* device files, usually found in the /dev
	  directory on your system.  They make it possible to have user-space
	  programs use the I3C devices.

	  This support is also available as a module.  If so, the module
	  will be called i3cdev.

	  Note that this application programming interface is EXPERIMENTAL
	  and hence SUBJECT TO CHANGE WITHOUT NOTICE while it stabilizes.

config I3C_MUX_IMX3102
	bool "IMX/IML3102 I3C multiplexer driver"
	default y
	select REGMAP_I3C
	help
	  Say y to enable Renesas IMX3102 I3C 2:1 multiplexer.

source "drivers/i3c/mctp/Kconfig"
source "drivers/i3c/master/Kconfig"

config I3C_HUB
	tristate "I3C HUB support"
	depends on I3C
	select REGMAP_I3C
	help
	  This enables support for I3C HUB. Say Y here to use I3C HUB driver to
	  configure I3C HUB device.

	  I3C HUB drivers will be loaded automatically when I3C device with BCR
	  equals to 0xC2 (HUB device) is detected on the bus.

config I3C_HUB_POLLING_MODE
	bool "Enable polling mode for I3C Hub SMBus Agent"
	default n
	depends on I3C_HUB
	help
	  This makes I3C HUB to get the SMBus Agent events with polling mode"

config I3C_HUB_TP_IDENDIFY
	bool "I3C Hub Identification by Target Port"
	default n
	depends on I3C_HUB
	help
	  Iendify the I3C Hub instance by a target port

config I3C_HUB_IDENTIFY_TP_NR
	int "Target Port used for Hub Identification"
	default 0
	range 0 7
	depends on I3C_HUB_TP_IDENDIFY
	help
	  Select which target port is used for the identification.


endif # I3C
```

## drivers/phy/aspeed/Kconfig
```kconfig
# SPDX-License-Identifier: GPL-2.0-only

#
# PHY drivers for ASPEED
#

config PHY_ASPEED_PCIE
	tristate "ASPEED PCIe PHY driver"
	select GENERIC_PHY
	depends on ARCH_ASPEED
	help
	  This option enables support for the ASPEED PCIe PHY driver.
	  The driver provides the necessary interface to control and
	  configure the PCIe PHY hardware found on ASPEED SoCs.
	  It is required for proper operation of PCIe devices on
	  platforms using ASPEED chips.

config PHY_ASPEED_COMBINE_PERST
	bool "ASPEED PCIe RC combine PERST with internal reset"
	depends on ARCH_ASPEED
	help
	  Configure PERST to connect with the internal PHY reset. When
	  this option is disabled, the driver selects the separate internal
	  PHY reset path by default. Enable it only on boards that require
	  PERST and the internal PHY reset to toggle at the same time.

config PHY_ASPEED_SGMII
	tristate "ASPEED SGMII PHY driver"
	select REGMAP
	select MFD_SYSCON
	select GENERIC_PHY
	depends on ARCH_ASPEED
	default n
	help
	  Enable driver support for Aspeed AST2700 PHY SGMII.

config PHY_ASPEED_USB3
	tristate "ASPEED USB3 PHY driver"
	select GENERIC_PHY
	depends on (ARCH_ASPEED || COMPILE_TEST)
	help
	  Enable driver support for Aspeed AST2700 USB3 PHY.
```
