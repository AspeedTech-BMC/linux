## drivers/pinctrl/aspeed/Kconfig
```kconfig
# SPDX-License-Identifier: GPL-2.0-only
config PINCTRL_ASPEED
	bool
	depends on (ARCH_ASPEED || COMPILE_TEST) && OF
	select MFD_SYSCON
	select PINMUX
	select PINCONF
	select GENERIC_PINCONF
	select REGMAP_MMIO

config PINCTRL_ASPEED_G4
	bool "Aspeed G4 SoC pin control"
	depends on (MACH_ASPEED_G4 || COMPILE_TEST) && OF
	select PINCTRL_ASPEED
	help
	  Say Y here to enable pin controller support for Aspeed's 4th
	  generation SoCs. GPIO is provided by a separate GPIO driver.

config PINCTRL_ASPEED_G5
	bool "Aspeed G5 SoC pin control"
	depends on (MACH_ASPEED_G5 || COMPILE_TEST) && OF
	select PINCTRL_ASPEED
	help
	  Say Y here to enable pin controller support for Aspeed's 5th
	  generation SoCs. GPIO is provided by a separate GPIO driver.

config PINCTRL_ASPEED_G6
	bool "Aspeed G6 SoC pin control"
	depends on (MACH_ASPEED_G6 || COMPILE_TEST) && OF
	select PINCTRL_ASPEED
	help
	  Say Y here to enable pin controller support for Aspeed's 6th
	  generation SoCs. GPIO is provided by a separate GPIO driver.

config PINCTRL_ASPEED_G7
	bool "Aspeed G7 SoC pin control"
	depends on (ARCH_ASPEED || COMPILE_TEST) && OF
	select PINCTRL_ASPEED
	help
	  Say Y here to enable pin controller support for Aspeed's 7th
	  generation SoCs (soc0 and ltpi are shared with g75; this also
	  covers g7's own soc1, see PINCTRL_ASPEED_G7_SOC1). GPIO is
	  provided by a separate GPIO driver.

config PINCTRL_ASPEED_G7_SOC1
	bool "Aspeed G7 SoC1 (ast2700) pin control"
	depends on PINCTRL_ASPEED_G7
	default y
	help
	  Say Y here to enable the g7 (ast2700) variant's own soc1 pin
	  controller. Say N if this kernel image only needs to support g75
	  (ast2705) boards and doesn't need g7's soc1 driver.

config PINCTRL_ASPEED_G75
	bool "Aspeed G75 SoC pin control"
	depends on (ARCH_ASPEED || COMPILE_TEST) && OF
	select PINCTRL_ASPEED
	select PINCTRL_ASPEED_G7
	help
	  Say Y here to enable pin controller support for Aspeed's G75
	  generation SoCs. GPIO is provided by a separate GPIO driver.
	  G75 reuses g7's soc0 and ltpi pin controllers, so this selects
	  PINCTRL_ASPEED_G7.
```

## drivers/soc/aspeed/espi/Kconfig
```kconfig
menu "ASPEED eSPI drivers"

config ASPEED_ESPI
        tristate "ASPEED eSPI slave driver"
        help
          Enable driver support for Aspeed AST2700 eSPI engine. The eSPI engine
          plays as a slave device in BMC to communicate with the Host over
          the eSPI interface. The four eSPI channels, namely peripheral,
          virtual wire, out-of-band, and flash are supported.

config AST2700_RTC_OVER_ESPI
        tristate "ASPEED AST2700 RTC over eSPI drvier"
        depends on HAS_IOMEM
        help
          Enable driver support for Aspeed AST2700 RTC over eSPI function.
          Periodically copies RAM content from a RTC tm to a memory-mapped eSPI region.

endmenu
```

## drivers/soc/aspeed/mmbi/Kconfig
```kconfig
menu "ASPEED MMBI driver"

config ASPEED_MMBI
	tristate "ASPEED MMBI driver"
	help
	  Enable support for the ASPEED MMBI driver. This driver
	  provides a communication channel between the Host and the BMC
	  over PCIe using the MMBI (Memory Mapped Buffer Interface).

config ASPEED_PCIE_MMBI
	tristate "ASPEED PCIE MMBI"
	depends on ASPEED_MMBI

config ASPEED_HOST_PCIE_MMBI
	tristate "ASPEED Host PCIE MMBI"

endmenu
```
