## Documentation/devicetree/bindings/iio/adc/aspeed,ast2600-adc.yaml
```yaml
# SPDX-License-Identifier: (GPL-2.0 OR BSD-2-Clause)
%YAML 1.2
---
$id: http://devicetree.org/schemas/iio/adc/aspeed,ast2600-adc.yaml#
$schema: http://devicetree.org/meta-schemas/core.yaml#

title: ADC that forms part of an ASPEED server management processor.

maintainers:
  - Billy Tsai <billy_tsai@aspeedtech.com>

description: |
  • 10-bits resolution for 16 voltage channels.
  • The device split into two individual engine and each contains 8 voltage
  channels.
  • Channel scanning can be non-continuous.
  • Programmable ADC clock frequency.
  • Programmable upper and lower threshold for each channels.
  • Interrupt when larger or less than threshold for each channels.
  • Support hysteresis for each channels.
  • Built-in a compensating method.
  • Built-in a register to trim internal reference voltage.
  • Internal or External reference voltage.
  • AST2600 and AST2700 support 1.2V or 2.5V internal reference
  voltage and 0.9V to 2.7V external reference voltage. AST2705 supports only
  1.2V internal reference voltage or 1.0V to 1.8V external reference voltage.
  • Integrate dividing circuit for battery sensing.

properties:
  compatible:
    enum:
      - aspeed,ast2600-adc0
      - aspeed,ast2600-adc1
      - aspeed,ast2700-adc0
      - aspeed,ast2700-adc1
      - aspeed,ast2705-adc0
      - aspeed,ast2705-adc1
    description:
      Their trimming data, which is used to calibrate internal reference volage,
      locates in different address of OTP.

  reg:
    maxItems: 1

  clocks:
    maxItems: 1
    description:
      Input clock used to derive the sample clock. Expected to be the
      SoC's APB clock.

  resets:
    maxItems: 1

  "#io-channel-cells":
    const: 1

  vref-supply:
    description:
      The external regulator supply ADC reference voltage.

  aspeed,int-vref-microvolt:
    enum: [1200000, 2500000]
    description:
      ADC internal reference voltage in microvolts. AST2600 and AST2700 accept
      1200000 or 2500000; AST2705 accepts only 1200000.

  aspeed,battery-sensing:
    type: boolean
    description:
      Inform the driver that last channel will be used to sensor battery.

required:
  - compatible
  - reg
  - clocks
  - resets
  - "#io-channel-cells"

additionalProperties: false

examples:
  - |
    #include <dt-bindings/clock/ast2600-clock.h>
    adc0: adc@1e6e9000 {
        compatible = "aspeed,ast2600-adc0";
        reg = <0x1e6e9000 0x100>;
        clocks = <&syscon ASPEED_CLK_APB2>;
        resets = <&syscon ASPEED_RESET_ADC>;
        #io-channel-cells = <1>;
        aspeed,int-vref-microvolt = <2500000>;
    };
    adc1: adc@1e6e9100 {
        compatible = "aspeed,ast2600-adc1";
        reg = <0x1e6e9100 0x100>;
        clocks = <&syscon ASPEED_CLK_APB2>;
        resets = <&syscon ASPEED_RESET_ADC>;
        #io-channel-cells = <1>;
        aspeed,int-vref-microvolt = <2500000>;
    };
...
```

## Documentation/devicetree/bindings/interrupt-controller/aspeed,ast2700-intc0.yaml
```yaml
# SPDX-License-Identifier: (GPL-2.0-only OR BSD-2-Clause)
%YAML 1.2
---
$id: http://devicetree.org/schemas/interrupt-controller/aspeed,ast2700-intc0.yaml#
$schema: http://devicetree.org/meta-schemas/core.yaml#

title: ASPEED AST2700 Primary Interrupt Controller (INTC0)

description: |
  The INTC0 block on the ASPEED AST2700 SoC routes external and internal
  interrupt sources to an upstream interrupt controller.

  Upstream interrupt controllers may include the ARM GIC instance used
  by the Primary Service Processor (PSP, Cortex-A35), as well as interrupt
  controllers associated with other cores such as the Secondary Service
  Processor (SSP, Cortex-M4) and the Tertiary Service Processor (TSP, Cortex-M4).
  It supports:
    - Direct INT lines
    - INT banked INT lines
    - Software interrupts (SWINT) from secondary/tertiary cores
    - Multiplexed INTM lines feeding the INTC1 controller


maintainers:
  - ryan_chen@aspeedtech.com

properties:
  compatible:
    const: aspeed,ast2700-intc0-ic

  reg:
    maxItems: 1

  interrupt-controller: true

  '#interrupt-cells':
    const: 1
    description:
      Single cell encoding the INTC0 interrupt number (hwirq).

  aspeed,interrupt-ranges:
    description: |
      Describes how ranges of parent interrupts are routed through INTC0.

      Each range is encoded as 6 cells:

        <int_pin count phandle type parent_irq flags>

      where:
        - int_pin:   First INTC0 interrupt number in this range.
        - count:     Number of consecutive INTC0 interrupts and parent
                     interrupts in this range.
        - phandle:   Phandle to the parent interrupt controller node.
        - type:      Parent interrupt type, as defined by the parent
                     interrupt controller binding (e.g. GIC_SPI).
        - parent_irq: First parent interrupt number in the range.
        - flags:     Parent interrupt flags (trigger type, etc.), as
                     defined by the parent interrupt controller binding.

      The driver only uses entries whose phandle matches the node
      referenced by interrupt-parent. The (type, parent_irq, flags)
      triplet is interpreted according to the interrupt specifier format
      of that parent controller (for GICv3 this is <type irq flags>).
    $ref: /schemas/types.yaml#/definitions/uint32-array
    minItems: 6
    items:
      description: 6-cell range descriptors.

required:
  - '#interrupt-cells'
  - compatible
  - reg
  - interrupt-controller
  - aspeed,interrupt-ranges

additionalProperties: false

examples:
  - |
    #include <dt-bindings/interrupt-controller/arm-gic.h>

    intc0: interrupt-controller@12100000 {
        compatible = "aspeed,ast2700-intc0-ic";
        reg = <0x12100000 0x3b00>;
        interrupt-controller;
        interrupt-parent = <&gic>;
        #interrupt-cells = <1>;

        aspeed,interrupt-ranges =
          /* Direct INT lines 0..127 routed 1:1 to GIC SPIs 0..127 */
          <0   128 &gic GIC_SPI 0   IRQ_TYPE_LEVEL_HIGH>,
          /* SWINT window: INTC0 SWINT 480..495 -> GIC SPIs 144..159 */
          <480 16  &gic GIC_SPI 144 IRQ_TYPE_LEVEL_HIGH>,
          /* INTM window feeding INTC1: INTC0 INTM 496..545 -> GIC SPIs 192..241 */
          <496 50  &gic GIC_SPI 192 IRQ_TYPE_LEVEL_HIGH>;
    };
```

## Documentation/devicetree/bindings/interrupt-controller/aspeed,ast2700-intc1.yaml
```yaml
# SPDX-License-Identifier: (GPL-2.0-only OR BSD-2-Clause)
%YAML 1.2
---
$id: http://devicetree.org/schemas/interrupt-controller/aspeed,ast2700-intc1.yaml#
$schema: http://devicetree.org/meta-schemas/core.yaml#

title: ASPEED AST2700 Secondary Interrupt Controller (INTC1)

description: |
  The INTC1 block on the ASPEED AST2700 SoC is a banked interrupt
  controller fed from INTC0 via INTM signals. It typically routes
  interrupts for secondary microcontrollers (e.g. SSP/TSP/RISC-V).

maintainers:
  - ryan_chen@aspeedtech.com

properties:
  compatible:
    const: aspeed,ast2700-intc1-ic

  reg:
    maxItems: 1

  interrupt-controller: true

  '#interrupt-cells':
    const: 2
    description:
      The first cell encodes the bank number, the second cell
      encodes the bit number within that bank (0-31). The mapping
      from the linear interrupt number to (bank, bit) is
      implementation-defined by the INTC1 hardware and driver.

  aspeed,interrupt-ranges:
    description: |
      Describes how ranges of parent interrupts (from INTC0) are
      routed into the INTC1 controller.

      Each range is encoded as 4 cells:

        <intm_pin count phandle base_irq>

      where:
        - intm_pin:  First INTC1 interrupt number in this range.
        - count:     Number of consecutive INTC1 interrupts and parent
                     INTC0 interrupts in this range.
        - phandle:   Phandle to the parent interrupt controller node
                     (typically the INTC0 controller).
        - base_irq:  First parent interrupt number in the range.

      The driver only uses entries whose phandle matches the node
      referenced by interrupt-parent (&intc0). The base_irq value is
      interpreted as a single-cell interrupt specifier understood by
      the parent controller binding for INTC0.
    $ref: /schemas/types.yaml#/definitions/uint32-array
    minItems: 4
    items:
      description: 4-cell range descriptors.

required:
  - '#interrupt-cells'
  - compatible
  - reg
  - interrupt-controller
  - aspeed,interrupt-ranges

additionalProperties: false

examples:
  - |
    intc1: interrupt-controller@14c18000 {
        compatible = "aspeed,ast2700-intc1-ic";
        reg = <0x14c18000 0x400>;
        interrupt-controller;
        #interrupt-cells = <2>;
        interrupt-parent = <&intc0>;

        /*
         * Example only: map 6 consecutive INTC1 interrupts starting at
         * intm_pin 0 to 6 consecutive INTC0 interrupts starting at
         * hwirq 496.
         */
        aspeed,interrupt-ranges =
          <0 6 &intc0 496>;
    };
...
```

## Documentation/devicetree/bindings/pci/aspeed-pcie-cfg.yaml
```yaml
# SPDX-License-Identifier: (GPL-2.0-only OR BSD-2-Clause)
%YAML 1.2
---
$id: http://devicetree.org/schemas/pci/aspeed-pcie-cfg.yaml#
$schema: http://devicetree.org/meta-schemas/core.yaml#

title: ASPEED PCIe Configuration

maintainers:
  - Jacky Chou <jacky_chou@aspeedtech.com>

description: |
  The ASPEED PCIe configuration syscon block provides a set of registers shared
  by multiple PCIe-related devices within the SoC. This node represents the
  common configuration space that allows these devices to coordinate and manage
  shared PCIe settings, including address mapping, control, and status
  registers. The syscon interface enables Linux drivers for various PCIe devices
  to access  and modify these shared registers in a consistent and centralized
  manner.

properties:
  compatible:
    enum:
      - aspeed,ast2600-pcie-cfg
      - aspeed,ast2700-pcie-cfg

  reg:
    maxItems: 1

required:
  - compatible
  - reg

additionalProperties: false

examples:
  - |
    pcie-cfg@1e770000 {
      compatible = "aspeed,ast2600-pcie-cfg";
      reg = <0x1e770000 0x80>;
    };
```

## Documentation/devicetree/bindings/pci/aspeed-pcie.yaml
```yaml
# SPDX-License-Identifier: (GPL-2.0-only OR BSD-2-Clause)
%YAML 1.2
---
$id: http://devicetree.org/schemas/pci/aspeed-pcie.yaml#
$schema: http://devicetree.org/meta-schemas/core.yaml#

title: ASPEED PCIe Root Complex Controller

maintainers:
  - Jacky Chou <jacky_chou@aspeedtech.com>

description: |
  Device tree binding for the ASPEED PCIe Root Complex controller.

properties:
  compatible:
    enum:
      - aspeed,ast2600-pcie
      - aspeed,ast2700-pcie

  device_type:
    const: pci

  reg:
    maxItems: 1

  ranges:
    minItems: 2
    maxItems: 2

  interrupts:
    description: IntX and MSI interrupt

  resets:
    items:
      - description: Module reset
      - description: PCIe PERST

  reset-names:
    items:
      - const: h2x
      - const: perst

  msi-parent: true

  msi_address:
    $ref: /schemas/types.yaml#/definitions/uint32
    description: MSI address

  aspeed,ahbc:
    $ref: /schemas/types.yaml#/definitions/phandle
    description: Phandle to ASPEED AHBC syscon.

  aspeed,pciecfg:
    $ref: /schemas/types.yaml#/definitions/phandle
    description: Phandle to ASPEED PCIe configuration syscon.

  aspeed,pciephy:
    $ref: /schemas/types.yaml#/definitions/phandle
    description: Phandle to ASPEED PCIe PHY syscon.

  clocks:
    description: PCIe BUS clock

  interrupt-controller:
    description: Interrupt controller node for handling legacy PCI interrupts.
    type: object
    properties:
      '#address-cells':
        const: 0
      '#interrupt-cells':
        const: 1
      interrupt-controller: true

    required:
      - '#address-cells'
      - '#interrupt-cells'
      - interrupt-controller

    additionalProperties: false

allOf:
  - $ref: /schemas/pci/pci-bus.yaml#
  - $ref: /schemas/interrupt-controller/msi-controller.yaml#
  - if:
      properties:
        compatible:
          contains:
            const: aspeed,ast2600-pcie
    then:
      required:
        - aspeed,ahbc

required:
  - interrupts
  - bus-range
  - ranges
  - resets
  - reset-names
  - msi-parent
  - msi-controller
  - aspeed,pciephy
  - aspeed,pciecfg
  - interrupt-map-mask
  - interrupt-map
  - interrupt-controller

unevaluatedProperties: false

examples:
  - |
    #include <dt-bindings/interrupt-controller/arm-gic.h>
    #include <dt-bindings/clock/ast2600-clock.h>

    apb {
      #address-cells = <1>;
      #size-cells = <1>;

      pcie0: pcie@1e7700C0 {
        compatible = "aspeed,ast2600-pcie";
        device_type = "pci";
        reg = <0x1e7700C0 0x40>;
        linux,pci-domain = <0>;
        #address-cells = <3>;
        #size-cells = <2>;
        interrupts = <GIC_SPI 168 IRQ_TYPE_LEVEL_HIGH>;
        bus-range = <0x80 0xff>;

        ranges = <0x01000000 0x0 0x00018000 0x00018000 0x0 0x00008000
                  0x02000000 0x0 0x70000000 0x70000000 0x0 0x10000000>;

        resets = <&syscon ASPEED_RESET_H2X>,
                 <&syscon ASPEED_RESET_PCIE_RC_O>;
        reset-names = "h2x", "perst";
        clocks = <&syscon ASPEED_CLK_GATE_BCLK>;
        pinctrl-names = "default";
        pinctrl-0 = <&pinctrl_pcierc1_default>;

        #interrupt-cells = <1>;
        msi-parent = <&pcie0>;
        msi-controller;
        msi_address = <0x1e77005C>;

        aspeed,ahbc = <&ahbc>;
        aspeed,pciecfg = <&pciecfg>;
        aspeed,pciephy = <&pcie_phy1>;

        interrupt-map-mask = <0 0 0 7>;
        interrupt-map = <0 0 0 1 &pcie_intc0 0>,
                        <0 0 0 2 &pcie_intc0 1>,
                        <0 0 0 3 &pcie_intc0 2>,
                        <0 0 0 4 &pcie_intc0 3>;
        pcie_intc0: interrupt-controller {
          interrupt-controller;
          #address-cells = <0>;
          #interrupt-cells = <1>;
        };
      };
    };
```

## Documentation/devicetree/bindings/phy/aspeed-pcie-phy.yaml
```yaml
# SPDX-License-Identifier: (GPL-2.0-only OR BSD-2-Clause)
%YAML 1.2
---
$id: http://devicetree.org/schemas/phy/aspeed-pcie-phy.yaml#
$schema: http://devicetree.org/meta-schemas/core.yaml#

title: ASPEED PCIe PHY

maintainers:
  - Jacky Chou <jacky_chou@aspeedtech.com>

description: |
  The ASPEED PCIe PHY provides the physical layer interface for PCIe
  controllers in the SoC. This node represents the register block for the PCIe
  PHY, which is typically accessed by PCIe Root Complex or Endpoint drivers
  via syscon.

properties:
  compatible:
    enum:
      - aspeed,ast2600-pcie-phy
      - aspeed,ast2700-pcie-phy

  reg:
    maxItems: 1

required:
  - compatible
  - reg

additionalProperties: false

examples:
  - |
    pcie-phy@1e6ed200 {
      compatible = "aspeed,ast2600-pcie-phy";
      reg = <0x1e6ed200 0x100>;
    };
```
