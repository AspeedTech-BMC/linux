// SPDX-License-Identifier: GPL-2.0-or-later
// Copyright 2026 ASPEED Corp.

&pinctrl1 {
	pinctrl_espi1_default: espi1-default {
		function = "ESPI1";
		groups = "ESPI1";
	};

	pinctrl_lpc1_default: lpc1-default {
		function = "LPC1";
		groups = "LPC1";
	};

	pinctrl_tach0_default: tach0-default {
		function = "TACH0";
		groups = "TACH0";
	};

	pinctrl_thru0_default: thru0-default {
		function = "THRU0";
		groups = "THRU0";
	};

	pinctrl_scmgpo0_default: scmgpo0-default {
		function = "SCMGPO0";
		groups = "SCMGPO0";
	};

	pinctrl_tach1_default: tach1-default {
		function = "TACH1";
		groups = "TACH1";
	};

	pinctrl_scmgpo1_default: scmgpo1-default {
		function = "SCMGPO1";
		groups = "SCMGPO1";
	};

	pinctrl_tach2_default: tach2-default {
		function = "TACH2";
		groups = "TACH2";
	};

	pinctrl_thru1_default: thru1-default {
		function = "THRU1";
		groups = "THRU1";
	};

	pinctrl_scmgpo2_default: scmgpo2-default {
		function = "SCMGPO2";
		groups = "SCMGPO2";
	};

	pinctrl_tach3_default: tach3-default {
		function = "TACH3";
		groups = "TACH3";
	};

	pinctrl_scmgpo3_default: scmgpo3-default {
		function = "SCMGPO3";
		groups = "SCMGPO3";
	};

	pinctrl_tach4_default: tach4-default {
		function = "TACH4";
		groups = "TACH4";
	};

	pinctrl_ncts5_default: ncts5-default {
		function = "UART5";
		groups = "NCTS5";
	};

	pinctrl_ndcd5_default: ndcd5-default {
		function = "UART5";
		groups = "NDCD5";
	};

	pinctrl_ndsr5_default: ndsr5-default {
		function = "UART5";
		groups = "NDSR5";
	};

	pinctrl_nri5_default: nri5-default {
		function = "UART5";
		groups = "NRI5";
	};

	pinctrl_ndtr5_default: ndtr5-default {
		function = "UART5";
		groups = "NDTR5";
	};

	pinctrl_nrts5_default: nrts5-default {
		function = "UART5";
		groups = "NRTS5";
	};

	pinctrl_txd5_default: txd5-default {
		function = "UART5";
		groups = "TXD5";
	};

	pinctrl_rxd5_default: rxd5-default {
		function = "UART5";
		groups = "RXD5";
	};

	pinctrl_scmgpo4_default: scmgpo4-default {
		function = "SCMGPO4";
		groups = "SCMGPO4";
	};

	pinctrl_tach5_default: tach5-default {
		function = "TACH5";
		groups = "TACH5";
	};

	pinctrl_scmgpo5_default: scmgpo5-default {
		function = "SCMGPO5";
		groups = "SCMGPO5";
	};

	pinctrl_tach6_default: tach6-default {
		function = "TACH6";
		groups = "TACH6";
	};

	pinctrl_scmgpo6_default: scmgpo6-default {
		function = "SCMGPO6";
		groups = "SCMGPO6";
	};

	pinctrl_tach7_default: tach7-default {
		function = "TACH7";
		groups = "TACH7";
	};

	pinctrl_scmgpo7_default: scmgpo7-default {
		function = "SCMGPO7";
		groups = "SCMGPO7";
	};

	pinctrl_tach8_default: tach8-default {
		function = "TACH8";
		groups = "TACH8";
	};

	pinctrl_scmgpo8_default: scmgpo8-default {
		function = "SCMGPO8";
		groups = "SCMGPO8";
	};

	pinctrl_tach9_default: tach9-default {
		function = "TACH9";
		groups = "TACH9";
	};

	pinctrl_scmgpo9_default: scmgpo9-default {
		function = "SCMGPO9";
		groups = "SCMGPO9";
	};

	pinctrl_tach10_default: tach10-default {
		function = "TACH10";
		groups = "TACH10";
	};

	pinctrl_salt12_default: salt12-default {
		function = "SALT12";
		groups = "SALT12";
	};

	pinctrl_ncts6_default: ncts6-default {
		function = "UART6";
		groups = "NCTS6";
	};

	pinctrl_ndcd6_default: ndcd6-default {
		function = "UART6";
		groups = "NDCD6";
	};

	pinctrl_ndsr6_default: ndsr6-default {
		function = "UART6";
		groups = "NDSR6";
	};

	pinctrl_nri6_default: nri6-default {
		function = "UART6";
		groups = "NRI6";
	};

	pinctrl_ndtr6_default: ndtr6-default {
		function = "UART6";
		groups = "NDTR6";
	};

	pinctrl_nrts6_default: nrts6-default {
		function = "UART6";
		groups = "NRTS6";
	};

	pinctrl_txd6_default: txd6-default {
		function = "UART6";
		groups = "TXD6";
	};

	pinctrl_rxd6_default: rxd6-default {
		function = "UART6";
		groups = "RXD6";
	};

	pinctrl_scmgpo10_default: scmgpo10-default {
		function = "SCMGPO10";
		groups = "SCMGPO10";
	};

	pinctrl_tach11_default: tach11-default {
		function = "TACH11";
		groups = "TACH11";
	};

	pinctrl_salt13_default: salt13-default {
		function = "SALT13";
		groups = "SALT13";
	};

	pinctrl_scmgpo11_default: scmgpo11-default {
		function = "SCMGPO11";
		groups = "SCMGPO11";
	};

	pinctrl_tach12_default: tach12-default {
		function = "TACH12";
		groups = "TACH12";
	};

	pinctrl_salt14_default: salt14-default {
		function = "SALT14";
		groups = "SALT14";
	};

	pinctrl_scmgpi0_default: scmgpi0-default {
		function = "SCMGPI0";
		groups = "SCMGPI0";
	};

	pinctrl_tach13_default: tach13-default {
		function = "TACH13";
		groups = "TACH13";
	};

	pinctrl_salt15_default: salt15-default {
		function = "SALT15";
		groups = "SALT15";
	};

	pinctrl_scmgpi1_default: scmgpi1-default {
		function = "SCMGPI1";
		groups = "SCMGPI1";
	};

	pinctrl_tach14_default: tach14-default {
		function = "TACH14";
		groups = "TACH14";
	};

	pinctrl_pme_default: pme-default {
		function = "PME";
		groups = "PME";
	};

	pinctrl_pme1_default: pme1-default {
		function = "PME1";
		groups = "PME1";
	};

	pinctrl_scmgpi2_default: scmgpi2-default {
		function = "SCMGPI2";
		groups = "SCMGPI2";
	};

	pinctrl_tach15_default: tach15-default {
		function = "TACH15";
		groups = "TACH15";
	};

	pinctrl_smi_default: smi-default {
		function = "SMI";
		groups = "SMI";
	};

	pinctrl_smi1_default: smi1-default {
		function = "SMI1";
		groups = "SMI1";
	};

	pinctrl_scmgpi3_default: scmgpi3-default {
		function = "SCMGPI3";
		groups = "SCMGPI3";
	};

	pinctrl_pwm0_default: pwm0-default {
		function = "PWM0";
		groups = "PWM0";
	};

	pinctrl_siopbon0_default: siopbon0-default {
		function = "SIOPBON0";
		groups = "SIOPBON0";
	};

	pinctrl_pwm1_default: pwm1-default {
		function = "PWM1";
		groups = "PWM1";
	};

	pinctrl_siopbin0_default: siopbin0-default {
		function = "SIOPBIN0";
		groups = "SIOPBIN0";
	};

	pinctrl_pwm2_default: pwm2-default {
		function = "PWM2";
		groups = "PWM2";
	};

	pinctrl_sioscin0_default: sioscin0-default {
		function = "SIOSCIN0";
		groups = "SIOSCIN0";
	};

	pinctrl_pwm3_default: pwm3-default {
		function = "PWM3";
		groups = "PWM3";
	};

	pinctrl_sios3n0_default: sios3n0-default {
		function = "SIOS3N0";
		groups = "SIOS3N0";
	};

	pinctrl_pwm4_default: pwm4-default {
		function = "PWM4";
		groups = "PWM4";
	};

	pinctrl_sios5n0_default: sios5n0-default {
		function = "SIOS5N0";
		groups = "SIOS5N0";
	};

	pinctrl_pwm5_default: pwm5-default {
		function = "PWM5";
		groups = "PWM5";
	};

	pinctrl_siopwreqn0_default: siopwreqn0-default {
		function = "SIOPWREQN0";
		groups = "SIOPWREQN0";
	};

	pinctrl_pwm6_default: pwm6-default {
		function = "PWM6";
		groups = "PWM6";
	};

	pinctrl_sioonctrln0_default: sioonctrln0-default {
		function = "SIOONCTRLN0";
		groups = "SIOONCTRLN0";
	};

	pinctrl_pwm7_default: pwm7-default {
		function = "PWM7";
		groups = "PWM7";
	};

	pinctrl_siopwrgd0_default: siopwrgd0-default {
		function = "SIOPWRGD0";
		groups = "SIOPWRGD0";
	};

	pinctrl_ncts0_default: ncts0-default {
		function = "UART0";
		groups = "NCTS0";
	};

	pinctrl_ndcd0_default: ndcd0-default {
		function = "UART0";
		groups = "NDCD0";
	};

	pinctrl_ndsr0_default: ndsr0-default {
		function = "UART0";
		groups = "NDSR0";
	};

	pinctrl_nri0_default: nri0-default {
		function = "UART0";
		groups = "NRI0";
	};

	pinctrl_ndtr0_default: ndtr0-default {
		function = "UART0";
		groups = "NDTR0";
	};

	pinctrl_nrts0_default: nrts0-default {
		function = "UART0";
		groups = "NRTS0";
	};

	pinctrl_txd0_default: txd0-default {
		function = "UART0";
		groups = "TXD0";
	};

	pinctrl_rxd0_default: rxd0-default {
		function = "UART0";
		groups = "RXD0";
	};

	pinctrl_siopbon1_default: siopbon1-default {
		function = "SIOPBON1";
		groups = "SIOPBON1";
	};

	pinctrl_siopbin1_default: siopbin1-default {
		function = "SIOPBIN1";
		groups = "SIOPBIN1";
	};

	pinctrl_sioscin1_default: sioscin1-default {
		function = "SIOSCIN1";
		groups = "SIOSCIN1";
	};

	pinctrl_sios3n1_default: sios3n1-default {
		function = "SIOS3N1";
		groups = "SIOS3N1";
	};

	pinctrl_sios5n1_default: sios5n1-default {
		function = "SIOS5N1";
		groups = "SIOS5N1";
	};

	pinctrl_siopwreqn1_default: siopwreqn1-default {
		function = "SIOPWREQN1";
		groups = "SIOPWREQN1";
	};

	pinctrl_ncts1_default: ncts1-default {
		function = "UART1";
		groups = "NCTS1";
	};

	pinctrl_ndcd1_default: ndcd1-default {
		function = "UART1";
		groups = "NDCD1";
	};

	pinctrl_ndsr1_default: ndsr1-default {
		function = "UART1";
		groups = "NDSR1";
	};

	pinctrl_nri1_default: nri1-default {
		function = "UART1";
		groups = "NRI1";
	};

	pinctrl_ndtr1_default: ndtr1-default {
		function = "UART1";
		groups = "NDTR1";
	};

	pinctrl_nrts1_default: nrts1-default {
		function = "UART1";
		groups = "NRTS1";
	};

	pinctrl_txd1_default: txd1-default {
		function = "UART1";
		groups = "TXD1";
	};

	pinctrl_rxd1_default: rxd1-default {
		function = "UART1";
		groups = "RXD1";
	};

	pinctrl_sd_default: sd-default {
		function = "SD";
		groups = "SD";
	};

	pinctrl_salt2_default: salt2-default {
		function = "SALT2";
		groups = "SALT2";
	};

	pinctrl_salt3_default: salt3-default {
		function = "SALT3";
		groups = "SALT3";
	};

	pinctrl_txd2_default: txd2-default {
		function = "UART2";
		groups = "TXD2";
	};

	pinctrl_rxd2_default: rxd2-default {
		function = "UART2";
		groups = "RXD2";
	};

	pinctrl_ncts2_default: ncts2-default {
		function = "UART2";
		groups = "NCTS2";
	};

	pinctrl_ndcd2_default: ndcd2-default {
		function = "UART2";
		groups = "NDCD2";
	};

	pinctrl_ndsr2_default: ndsr2-default {
		function = "UART2";
		groups = "NDSR2";
	};

	pinctrl_nri2_default: nri2-default {
		function = "UART2";
		groups = "NRI2";
	};

	pinctrl_ndtr2_default: ndtr2-default {
		function = "UART2";
		groups = "NDTR2";
	};

	pinctrl_nrts2_default: nrts2-default {
		function = "UART2";
		groups = "NRTS2";
	};

	pinctrl_i3c12_default: i3c12-default {
		function = "I3C12";
		groups = "I3C12";
	};

	pinctrl_di3c12_default: di3c12-default {
		function = "I3C12";
		groups = "DI3C12";
	};

	pinctrl_i2c12_default: i2c12-default {
		function = "I2C12";
		groups = "I2C12";
	};

	pinctrl_txd3_default: txd3-default {
		function = "UART3";
		groups = "TXD3";
	};

	pinctrl_rxd3_default: rxd3-default {
		function = "UART3";
		groups = "RXD3";
	};

	pinctrl_txd3_alt_default: txd3_alt-default {
		function = "UART3";
		groups = "TXD3_ALT";
	};

	pinctrl_rxd3_alt_default: rxd3_alt-default {
		function = "UART3";
		groups = "RXD3_ALT";
	};

	pinctrl_wdtrst0n_default: wdtrst0n-default {
		function = "WDTRST0N";
		groups = "WDTRST0N";
	};

	pinctrl_wdtrst1n_default: wdtrst1n-default {
		function = "WDTRST1N";
		groups = "WDTRST1N";
	};

	pinctrl_wdtrst2n_default: wdtrst2n-default {
		function = "WDTRST2N";
		groups = "WDTRST2N";
	};

	pinctrl_i3c13_default: i3c13-default {
		function = "I3C13";
		groups = "I3C13";
	};

	pinctrl_di3c13_default: di3c13-default {
		function = "I3C13";
		groups = "DI3C13";
	};

	pinctrl_i2c13_default: i2c13-default {
		function = "I2C13";
		groups = "I2C13";
	};

	pinctrl_wdtrst3n_default: wdtrst3n-default {
		function = "WDTRST3N";
		groups = "WDTRST3N";
	};

	pinctrl_salt0_default: salt0-default {
		function = "SALT0";
		groups = "SALT0";
	};

	pinctrl_i3c14_default: i3c14-default {
		function = "I3C14";
		groups = "I3C14";
	};

	pinctrl_di3c14_default: di3c14-default {
		function = "I3C14";
		groups = "DI3C14";
	};

	pinctrl_i2c14_default: i2c14-default {
		function = "I2C14";
		groups = "I2C14";
	};

	pinctrl_salt1_default: salt1-default {
		function = "SALT1";
		groups = "SALT1";
	};

	pinctrl_txd7_default: txd7-default {
		function = "UART7";
		groups = "TXD7";
	};

	pinctrl_rxd7_default: rxd7-default {
		function = "UART7";
		groups = "RXD7";
	};

	pinctrl_i2c15_default: i2c15-default {
		function = "I2C15";
		groups = "I2C15";
	};

	pinctrl_i3c15_default: i3c15-default {
		function = "I3C15";
		groups = "I3C15";
	};

	pinctrl_di3c15_default: di3c15-default {
		function = "I3C15";
		groups = "DI3C15";
	};

	pinctrl_sgpm1_default: sgpm1-default {
		function = "SGPM1";
		groups = "SGPM1";
	};

	pinctrl_sgpm1ld_r_default: sgpm1ld_r-default {
		function = "SGPM1LD_R";
		groups = "SGPM1LD_R";
	};

	pinctrl_wdtrst7n_default: wdtrst7n-default {
		function = "WDTRST7N";
		groups = "WDTRST7N";
	};

	pinctrl_sff8485b_default: sff8485b-default {
		function = "SFF8485B";
		groups = "SFF8485B";
	};

	pinctrl_i3c4_default: i3c4-default {
		function = "I3C4";
		groups = "I3C4";
	};

	pinctrl_di3c4_default: di3c4-default {
		function = "I3C4";
		groups = "DI3C4";
	};

	pinctrl_i2c0_default: i2c0-default {
		function = "I2C0";
		groups = "I2C0";
	};

	pinctrl_di2c0_default: di2c0-default {
		function = "I2C0";
		groups = "DI2C0";
	};

	pinctrl_i3c5_default: i3c5-default {
		function = "I3C5";
		groups = "I3C5";
	};

	pinctrl_di3c5_default: di3c5-default {
		function = "I3C5";
		groups = "DI3C5";
	};

	pinctrl_i2c1_default: i2c1-default {
		function = "I2C1";
		groups = "I2C1";
	};

	pinctrl_di2c1_default: di2c1-default {
		function = "I2C1";
		groups = "DI2C1";
	};

	pinctrl_i3c6_default: i3c6-default {
		function = "I3C6";
		groups = "I3C6";
	};

	pinctrl_di3c6_default: di3c6-default {
		function = "I3C6";
		groups = "DI3C6";
	};

	pinctrl_i2c2_default: i2c2-default {
		function = "I2C2";
		groups = "I2C2";
	};

	pinctrl_di2c2_default: di2c2-default {
		function = "I2C2";
		groups = "DI2C2";
	};

	pinctrl_i3c7_default: i3c7-default {
		function = "I3C7";
		groups = "I3C7";
	};

	pinctrl_di3c7_default: di3c7-default {
		function = "I3C7";
		groups = "DI3C7";
	};

	pinctrl_i2c3_default: i2c3-default {
		function = "I2C3";
		groups = "I2C3";
	};

	pinctrl_di2c3_default: di2c3-default {
		function = "I2C3";
		groups = "DI2C3";
	};

	pinctrl_i3c8_default: i3c8-default {
		function = "I3C8";
		groups = "I3C8";
	};

	pinctrl_di3c8_default: di3c8-default {
		function = "I3C8";
		groups = "DI3C8";
	};

	pinctrl_fsi0_default: fsi0-default {
		function = "FSI0";
		groups = "FSI0";
	};

	pinctrl_i2c4_default: i2c4-default {
		function = "I2C4";
		groups = "I2C4";
	};

	pinctrl_di2c4_default: di2c4-default {
		function = "I2C4";
		groups = "DI2C4";
	};

	pinctrl_i3c9_default: i3c9-default {
		function = "I3C9";
		groups = "I3C9";
	};

	pinctrl_di3c9_default: di3c9-default {
		function = "I3C9";
		groups = "DI3C9";
	};

	pinctrl_fsi1_default: fsi1-default {
		function = "FSI1";
		groups = "FSI1";
	};

	pinctrl_i2c5_default: i2c5-default {
		function = "I2C5";
		groups = "I2C5";
	};

	pinctrl_di2c5_default: di2c5-default {
		function = "I2C5";
		groups = "DI2C5";
	};

	pinctrl_i3c10_default: i3c10-default {
		function = "I3C10";
		groups = "I3C10";
	};

	pinctrl_di3c10_default: di3c10-default {
		function = "I3C10";
		groups = "DI3C10";
	};

	pinctrl_fsi2_default: fsi2-default {
		function = "FSI2";
		groups = "FSI2";
	};

	pinctrl_i3c11_default: i3c11-default {
		function = "I3C11";
		groups = "I3C11";
	};

	pinctrl_di3c11_default: di3c11-default {
		function = "I3C11";
		groups = "DI3C11";
	};

	pinctrl_fsi3_default: fsi3-default {
		function = "FSI3";
		groups = "FSI3";
	};

	pinctrl_i3c0_default: i3c0-default {
		function = "I3C0";
		groups = "I3C0";
	};

	pinctrl_di3c0_default: di3c0-default {
		function = "I3C0";
		groups = "DI3C0";
	};

	pinctrl_i3c1_default: i3c1-default {
		function = "I3C1";
		groups = "I3C1";
	};

	pinctrl_di3c1_default: di3c1-default {
		function = "I3C1";
		groups = "DI3C1";
	};

	pinctrl_i3c2_default: i3c2-default {
		function = "I3C2";
		groups = "I3C2";
	};

	pinctrl_di3c2_default: di3c2-default {
		function = "I3C2";
		groups = "DI3C2";
	};

	pinctrl_i3c3_default: i3c3-default {
		function = "I3C3";
		groups = "I3C3";
	};

	pinctrl_di3c3_default: di3c3-default {
		function = "I3C3";
		groups = "DI3C3";
	};

	pinctrl_espi0_default: espi0-default {
		function = "ESPI0";
		groups = "ESPI0";
	};

	pinctrl_lpc0_default: lpc0-default {
		function = "LPC0";
		groups = "LPC0";
	};

	pinctrl_oscclk_default: oscclk-default {
		function = "OSCCLK";
		groups = "OSCCLK";
	};

	pinctrl_spi0_default: spi0-default {
		function = "SPI0";
		groups = "SPI0";
	};

	pinctrl_spi0_quad_default: spi0-quad-default {
		function = "QSPI0";
		groups = "QSPI0";
	};

	pinctrl_spi0_cs1_default: spi0-cs1-default {
		function = "SPI0CS1";
		groups = "SPI0CS1";
	};

	pinctrl_spi0abr_default: spi0abr-default {
		function = "SPI0ABR";
		groups = "SPI0ABR";
	};

	pinctrl_sioonctrln1_default: sioonctrln1-default {
		function = "SIOONCTRLN1";
		groups = "SIOONCTRLN1";
	};

	pinctrl_txd8_default: txd8-default {
		function = "UART8";
		groups = "TXD8";
	};

	pinctrl_rxd8_default: rxd8-default {
		function = "UART8";
		groups = "RXD8";
	};

	pinctrl_spi0wpn_default: spi0wpn-default {
		function = "SPI0WPN";
		groups = "SPI0WPN";
	};

	pinctrl_siopwrgd1_default: siopwrgd1-default {
		function = "SIOPWRGD1";
		groups = "SIOPWRGD1";
	};

	pinctrl_spi1_default: spi1-default {
		function = "SPI1";
		groups = "SPI1";
	};

	pinctrl_txd9_default: txd9-default {
		function = "UART9";
		groups = "TXD9";
	};

	pinctrl_rxd9_default: rxd9-default {
		function = "UART9";
		groups = "RXD9";
	};

	pinctrl_txd10_default: txd10-default {
		function = "UART10";
		groups = "TXD10";
	};

	pinctrl_rxd10_default: rxd10-default {
		function = "UART10";
		groups = "RXD10";
	};

	pinctrl_spi1_quad_default: spi1-quad-default {
		function = "QSPI1";
		groups = "QSPI1";
	};

	pinctrl_txd11_default: txd11-default {
		function = "UART11";
		groups = "TXD11";
	};

	pinctrl_rxd11_default: rxd11-default {
		function = "UART11";
		groups = "RXD11";
	};

	pinctrl_spi1_cs1_default: spi1-cs1-default {
		function = "SPI1CS1";
		groups = "SPI1CS1";
	};

	pinctrl_spi1abr_default: spi1abr-default {
		function = "SPI1ABR";
		groups = "SPI1ABR";
	};

	pinctrl_recovery_default: recovery-default {
		function = "RECOVERY";
		groups = "RECOVERY";
	};

	pinctrl_i3c_default: i3c-default {
		function = "I3C";
		groups = "I3C";
	};

	pinctrl_thru2_default: thru2-default {
		function = "THRU2";
		groups = "THRU2";
	};

	pinctrl_spi1wpn_default: spi1wpn-default {
		function = "SPI1WPN";
		groups = "SPI1WPN";
	};

	pinctrl_spi2_default: spi2-default {
		function = "SPI2";
		groups = "SPI2";
	};

	pinctrl_spi2_quad_default: spi2-quad-default {
		function = "QSPI2";
		groups = "QSPI2";
	};

	pinctrl_thru3_default: thru3-default {
		function = "THRU3";
		groups = "THRU3";
	};

	pinctrl_spi2_cs1_default: spi2-cs1-default {
		function = "SPI2CS1";
		groups = "SPI2CS1";
	};

	pinctrl_fwspiabr_default: fwspiabr-default {
		function = "FWSPIABR";
		groups = "FWSPIABR";
	};

	pinctrl_mdio2_default: mdio2-default {
		function = "MDIO2";
		groups = "MDIO2";
	};

	pinctrl_pcierc2_perst_default: pcierc2-perst-default {
		function = "PCIERC";
		groups = "PE2SGRSTN";
	};

	pinctrl_sgmii_default: sgmii-default {
		function = "SGMII";
		groups = "SGMII";
	};

	pinctrl_usb2cud_default: usb2cud-default {
		function = "USB2C";
		groups = "USB2CUD";
	};

	pinctrl_usb2cd_default: usb2cd-default {
		function = "USB2C";
		groups = "USB2CD";
	};

	pinctrl_usb2ch_default: usb2ch-default {
		function = "USB2C";
		groups = "USB2CH";
	};

	pinctrl_usb2cu_default: usb2cu-default {
		function = "USB2C";
		groups = "USB2CU";
	};

	pinctrl_usb2dd_default: usb2dd-default {
		function = "USB2D";
		groups = "USB2DD";
	};

	pinctrl_usb2dh_default: usb2dh-default {
		function = "USB2D";
		groups = "USB2DH";
	};

	pinctrl_jtagm1trst_default: jtagm1trst-default {
		function = "JTAGM1TRST";
		groups = "JTAGM1TRST";
	};

	pinctrl_jtagm1_default: jtagm1-default {
		function = "JTAGM1";
		groups = "JTAGM1";
	};

	pinctrl_cptra_default: cptra-default {
		function = "CPTRA";
		groups = "CPTRA";
	};

	pinctrl_cptra_trstn_default: cptra_trstn-default {
		function = "CPTRA_TRSTN";
		groups = "CPTRA_TRSTN";
	};

	pinctrl_fwspiwpn_default: fwspiwpn-default {
		function = "FWSPIWPN";
		groups = "FWSPIWPN";
	};

	pinctrl_rgmii0_default: rgmii0-default {
		function = "RGMII0";
		groups = "RGMII0";
	};

	pinctrl_rmii0_default: rmii0-default {
		function = "RMII0";
		groups = "RMII0";
	};

	pinctrl_rmii0_rclko_default: rmii0-rclko-default {
		function = "RMII0RCLKO";
		groups = "RMII0RCLKO";
	};

	pinctrl_mdio0_default: mdio0-default {
		function = "MDIO0";
		groups = "MDIO0";
	};

	pinctrl_vga_default: vga-default {
		function = "VGA";
		groups = "VGA";
	};

	pinctrl_rgmii1_default: rgmii1-default {
		function = "RGMII1";
		groups = "RGMII1";
	};

	pinctrl_rmii1_default: rmii1-default {
		function = "RMII1";
		groups = "RMII1";
	};

	pinctrl_rmii1_rclko_default: rmii1-rclko-default {
		function = "RMII1RCLKO";
		groups = "RMII1RCLKO";
	};

	pinctrl_sgps_default: sgps-default {
		function = "SGPS";
		groups = "SGPS";
	};

	pinctrl_mdio1_default: mdio1-default {
		function = "MDIO1";
		groups = "MDIO1";
	};

	pinctrl_fwspi_quad_default: fwspi-quad-default {
		function = "FWQSPI";
		groups = "FWQSPI";
	};

	pinctrl_ltpi_ps_i2c4_default: ltpi_ps_i2c4-default {
		function = "LTPI_PS_I2C4";
		groups = "LTPI_PS_I2C4";
	};

	pinctrl_ltpi_ps_i2c5_default: ltpi_ps_i2c5-default {
		function = "LTPI_PS_I2C5";
		groups = "LTPI_PS_I2C5";
	};

	pinctrl_i2c6_default: i2c6-default {
		function = "I2C6";
		groups = "I2C6";
	};

	pinctrl_i2c7_default: i2c7-default {
		function = "I2C7";
		groups = "I2C7";
	};

	pinctrl_i2c8_default: i2c8-default {
		function = "I2C8";
		groups = "I2C8";
	};

	pinctrl_i2c9_default: i2c9-default {
		function = "I2C9";
		groups = "I2C9";
	};

	pinctrl_i2c10_default: i2c10-default {
		function = "I2C10";
		groups = "I2C10";
	};

	pinctrl_can_default: can-default {
		function = "CANBUS";
		groups = "CANBUS";
	};

	pinctrl_i2c11_default: i2c11-default {
		function = "I2C11";
		groups = "I2C11";
	};

	pinctrl_adc0_default: adc0-default {
		function = "ADC0";
		groups = "ADC0";
	};

	pinctrl_gpiy0_default: gpiy0-default {
		function = "GPIY0";
		groups = "GPIY0";
	};

	pinctrl_salt4_default: salt4-default {
		function = "SALT4";
		groups = "SALT4";
	};

	pinctrl_adc1_default: adc1-default {
		function = "ADC1";
		groups = "ADC1";
	};

	pinctrl_gpiy1_default: gpiy1-default {
		function = "GPIY1";
		groups = "GPIY1";
	};

	pinctrl_salt5_default: salt5-default {
		function = "SALT5";
		groups = "SALT5";
	};

	pinctrl_adc2_default: adc2-default {
		function = "ADC2";
		groups = "ADC2";
	};

	pinctrl_gpiy2_default: gpiy2-default {
		function = "GPIY2";
		groups = "GPIY2";
	};

	pinctrl_salt6_default: salt6-default {
		function = "SALT6";
		groups = "SALT6";
	};

	pinctrl_adc3_default: adc3-default {
		function = "ADC3";
		groups = "ADC3";
	};

	pinctrl_gpiy3_default: gpiy3-default {
		function = "GPIY3";
		groups = "GPIY3";
	};

	pinctrl_salt7_default: salt7-default {
		function = "SALT7";
		groups = "SALT7";
	};

	pinctrl_adc4_default: adc4-default {
		function = "ADC4";
		groups = "ADC4";
	};

	pinctrl_gpiy4_default: gpiy4-default {
		function = "GPIY4";
		groups = "GPIY4";
	};

	pinctrl_salt8_default: salt8-default {
		function = "SALT8";
		groups = "SALT8";
	};

	pinctrl_adc5_default: adc5-default {
		function = "ADC5";
		groups = "ADC5";
	};

	pinctrl_gpiy5_default: gpiy5-default {
		function = "GPIY5";
		groups = "GPIY5";
	};

	pinctrl_salt9_default: salt9-default {
		function = "SALT9";
		groups = "SALT9";
	};

	pinctrl_adc6_default: adc6-default {
		function = "ADC6";
		groups = "ADC6";
	};

	pinctrl_gpiy6_default: gpiy6-default {
		function = "GPIY6";
		groups = "GPIY6";
	};

	pinctrl_salt10_default: salt10-default {
		function = "SALT10";
		groups = "SALT10";
	};

	pinctrl_adc7_default: adc7-default {
		function = "ADC7";
		groups = "ADC7";
	};

	pinctrl_gpiy7_default: gpiy7-default {
		function = "GPIY7";
		groups = "GPIY7";
	};

	pinctrl_salt11_default: salt11-default {
		function = "SALT11";
		groups = "SALT11";
	};

	pinctrl_adc8_default: adc8-default {
		function = "ADC8";
		groups = "ADC8";
	};

	pinctrl_gpiz0_default: gpiz0-default {
		function = "GPIZ0";
		groups = "GPIZ0";
	};

	pinctrl_adc9_default: adc9-default {
		function = "ADC9";
		groups = "ADC9";
	};

	pinctrl_gpiz1_default: gpiz1-default {
		function = "GPIZ1";
		groups = "GPIZ1";
	};

	pinctrl_adc10_default: adc10-default {
		function = "ADC10";
		groups = "ADC10";
	};

	pinctrl_gpiz2_default: gpiz2-default {
		function = "GPIZ2";
		groups = "GPIZ2";
	};

	pinctrl_adc11_default: adc11-default {
		function = "ADC11";
		groups = "ADC11";
	};

	pinctrl_gpiz3_default: gpiz3-default {
		function = "GPIZ3";
		groups = "GPIZ3";
	};

	pinctrl_adc12_default: adc12-default {
		function = "ADC12";
		groups = "ADC12";
	};

	pinctrl_gpiz4_default: gpiz4-default {
		function = "GPIZ4";
		groups = "GPIZ4";
	};

	pinctrl_adc13_default: adc13-default {
		function = "ADC13";
		groups = "ADC13";
	};

	pinctrl_gpiz5_default: gpiz5-default {
		function = "GPIZ5";
		groups = "GPIZ5";
	};

	pinctrl_auxpwrgood0_default: auxpwrgood0-default {
		function = "AUXPWRGOOD0";
		groups = "AUXPWRGOOD0";
	};

	pinctrl_auxpwrgood1_default: auxpwrgood1-default {
		function = "AUXPWRGOOD1";
		groups = "AUXPWRGOOD1";
	};

	pinctrl_adc14_default: adc14-default {
		function = "ADC14";
		groups = "ADC14";
	};

	pinctrl_gpiz6_default: gpiz6-default {
		function = "GPIZ6";
		groups = "GPIZ6";
	};

	pinctrl_adc15_default: adc15-default {
		function = "ADC15";
		groups = "ADC15";
	};

	pinctrl_gpiz7_default: gpiz7-default {
		function = "GPIZ7";
		groups = "GPIZ7";
	};

	pinctrl_sgpm0_default: sgpm0-default {
		function = "SGPM0";
		groups = "SGPM0";
	};

	pinctrl_sgpm0ld_r_default: sgpm0ld_r-default {
		function = "SGPM0LD_R";
		groups = "SGPM0LD_R";
	};

	pinctrl_sff8485a_default: sff8485a-default {
		function = "SFF8485A";
		groups = "SFF8485A";
	};

	pinctrl_maclink0_default: maclink0-default {
		function = "MACLINK0";
		groups = "MACLINK0";
	};

	pinctrl_maclink2_default: maclink2-default {
		function = "MACLINK2";
		groups = "MACLINK2";
	};

	pinctrl_hbledn_default: hbledn-default {
		function = "HBLEDN";
		groups = "HBLEDN";
	};

	pinctrl_wdtrst4n_default: wdtrst4n-default {
		function = "WDTRST4N";
		groups = "WDTRST4N";
	};

	pinctrl_wdtrst5n_default: wdtrst5n-default {
		function = "WDTRST5N";
		groups = "WDTRST5N";
	};

	pinctrl_wdtrst6n_default: wdtrst6n-default {
		function = "WDTRST6N";
		groups = "WDTRST6N";
	};

	pinctrl_maclink1_default: maclink1-default {
		function = "MACLINK1";
		groups = "MACLINK1";
	};

};
